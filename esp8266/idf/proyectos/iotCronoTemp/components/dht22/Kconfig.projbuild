## esp8266/idf/proyectos/iotCronoTemp/components/dht22/Kconfig.projbuild
```kconfig
menu "Configuracion dht22"


config GPIO_PIN_DHT
	int "Pin gpio del sensor dht22"
	default 14
	help 
		Indica el pin gpio que se usa para el sensor

endmenu
```

## esp8266/idf/proyectos/iotTermometro/main/Kconfig.projbuild
```kconfig
menu "Configuracion iotTermometro"

config TIPO_DISPOSITIVO
	int "Tipo de dispositivo"
	default 0
	help
		indica el tipo de dispositivo
		0 interruptor.
		1 cronotermostato
		2 termometro


config GPIO_PIN_LED
	int "Pin gpio para activar el led"
	default 13
	help 
		Indica el pin gpio con el que se activa el LED


                Indica el pin gpi con el que se activa el boton
config GPIO_PIN_LED_ALARMA
        int "Pin gpio para encender la alarma"
        default 4
        help 
                Indica el pin gpi con el que se activa el boton


choice
        prompt "Seleccion del tipo de sensor de temperatura"
        default DHT22
        help
            Selecciona el tipo de sensor
    
        config DHT22
            bool "DHT22"
        config DS18B20
            bool "DS18B20"
        endchoice


endmenu
```
